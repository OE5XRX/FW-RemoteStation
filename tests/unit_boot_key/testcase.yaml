## tests/unit_boot_key/testcase.yaml
```yaml
# Copyright (c) 2026 OE5XRX
# SPDX-License-Identifier: LGPL-3.0-or-later

tests:
  module.boot_key:
    platform_allow:
      - native_sim/native/64
    tags:
      - module
      - mcuboot
    harness: ztest
```

## tests/unit_device_uid/testcase.yaml
```yaml
# Copyright (c) 2026 OE5XRX
# SPDX-License-Identifier: LGPL-3.0-or-later

tests:
  module.device_uid:
    platform_allow:
      - native_sim/native/64
    tags: module uid
    harness: ztest
```

## west.yml
```yaml
manifest:
  self:
    west-commands: scripts/west-commands.yml

  remotes:
    - name: zephyrproject-rtos
      url-base: https://github.com/zephyrproject-rtos
    - name: etlcpp
      url-base: https://github.com/ETLCPP

  projects:
    - name: zephyr
      remote: zephyrproject-rtos
      revision: 403a7d79adbce610cb611912190ba066d7c8903f
      import:
        name-allowlist:
          - cmsis_6
          - hal_stm32
          - mcuboot
    - name: etl
      remote: etlcpp
      revision: 20.48.0
      path: modules/lib/etl
```
