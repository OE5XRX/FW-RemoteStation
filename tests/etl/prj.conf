## CMakeLists.txt
```
# Copyright (c) 2025 OE5XRX
# SPDX-License-Identifier: LGPL-3.0-or-later

cmake_minimum_required(VERSION 3.20.0)

find_package(Zephyr REQUIRED HINTS $ENV{ZEPHYR_BASE})
project(etl_smoke)

target_sources(app PRIVATE
  ${CMAKE_CURRENT_LIST_DIR}/src/main.cpp
  ${CMAKE_CURRENT_LIST_DIR}/../../app/src/etl_error_handler.cpp
)
```

## prj.conf
```kconfig
# Copyright (c) 2025 OE5XRX
# SPDX-License-Identifier: LGPL-3.0-or-later

CONFIG_ZTEST=y

CONFIG_CPP=y
CONFIG_STD_CPP20=y
CONFIG_EXTERNAL_LIBCPP=y

CONFIG_LOG=y

CONFIG_ETL=y
CONFIG_ETL_LOG_ERRORS=y
```

## src/main.cpp
```c
/*
 * Copyright (c) 2025 OE5XRX
 * SPDX-License-Identifier: LGPL-3.0-or-later
 *
 * Proof that a real ETL type links and works on native_sim.
 */

#include <etl/string.h>
#include <zephyr/ztest.h>

ZTEST_SUITE(etl_smoke, NULL, NULL, NULL, NULL, NULL);

ZTEST(etl_smoke, test_string_append_compare) {
  etl::string<32> s("OE5");
  s.append("XRX");

  zassert_equal(s.size(), 6U, "unexpected size %u", (unsigned int)s.size());
  zassert_true(s == "OE5XRX", "content mismatch");
  zassert_equal(s.capacity(), 32U, "unexpected capacity %u", (unsigned int)s.capacity());
  zassert_false(s.full(), "string should not be full");
}
```
