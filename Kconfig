## boards/oe5xrx/fm_board/Kconfig
```kconfig
# Copyright (c) 2025 OE5XRX
# SPDX-License-Identifier: LGPL-3.0-or-later

# FM Board Kconfig

source "samples/subsys/usb/common/Kconfig.sample_usbd"
```

## boards/oe5xrx/fm_board/board.yml
```yaml
# Copyright (c) 2025 OE5XRX
# SPDX-License-Identifier: LGPL-3.0-or-later

# FM Board Metadata
# Board definition for OE5XRX FM transceiver hardware

board:
  name: fm_board
  full_name: FM-Transceiver for the OE5XRX Remote Station
  vendor: oe5xrx
  socs:
    - name: stm32f302xc
```

## boards/oe5xrx/fm_board/fm_board_defconfig
```kconfig
# Enable MPU
CONFIG_ARM_MPU=y

# Enable HW stack protection
CONFIG_HW_STACK_PROTECTION=y

# enable uart driver
CONFIG_SERIAL=y

# enable console
CONFIG_CONSOLE=y
CONFIG_UART_CONSOLE=y

# enable GPIO
CONFIG_GPIO=y

# enable DMA (used by the analog-audio-in/out LL+DMA capture/playback drivers)
CONFIG_DMA=y

# enable hardware-timed analog audio capture (TIM+ADC+DMA)
CONFIG_ANALOG_AUDIO_IN=y

# enable hardware-timed analog audio playback (TIM+DAC+DMA)
CONFIG_ANALOG_AUDIO_OUT=y

# enable regulators
CONFIG_REGULATOR=y

# USB Configuration
CONFIG_USB_DEVICE_STACK_NEXT=y
# The STM32U575 OTG is full-speed only (DT maximum-speed = "full-speed"). The
# STM32 UDC Kconfig selects UDC_DRIVER_HAS_HIGH_SPEED_SUPPORT, which otherwise
# defaults the device stack to High-Speed. Force full-speed to match the hardware
# and drop the unused high-speed descriptor/config support. Disabling the
# high-speed chirp is also what unlocks USBD_MAX_SPEED_FULL (its dependency is
# !UDC_DRIVER_HIGH_SPEED_SUPPORT_ENABLED).
CONFIG_UDC_DRIVER_HIGH_SPEED_SUPPORT_ENABLED=n
CONFIG_USBD_MAX_SPEED_FULL=y
CONFIG_SAMPLE_USBD_VID=0x2FE3
CONFIG_SAMPLE_USBD_PID=0x0012
CONFIG_SAMPLE_USBD_PRODUCT="FM Transceiver Board"
CONFIG_SAMPLE_USBD_MANUFACTURER="OE5XRX"
CONFIG_SAMPLE_USBD_SELF_POWERED=n
CONFIG_SAMPLE_USBD_MAX_POWER=250

# USB CDC ACM - Shell/Console
CONFIG_STDOUT_CONSOLE=y
CONFIG_UART_LINE_CTRL=y
CONFIG_USBD_CDC_ACM_CLASS=y
CONFIG_CDC_ACM_SERIAL_INITIALIZE_AT_BOOT=n

# USB Audio Class 2 - SA818 Audio Streaming
CONFIG_USBD_AUDIO2_CLASS=y

# USB DFU - Firmware Update
CONFIG_USBD_DFU=y

# Logging
CONFIG_LOG=y
CONFIG_USBD_LOG_LEVEL_WRN=y
CONFIG_UDC_DRIVER_LOG_LEVEL_WRN=y
CONFIG_USBD_CDC_ACM_LOG_LEVEL_OFF=y
```

## drivers/Kconfig
```kconfig
# SPDX-License-Identifier: LGPL-3.0-or-later
# Copyright (c) 2025 OE5XRX

rsource "radio/Kconfig"
rsource "dac/Kconfig"
```

## drivers/audio/Kconfig
```kconfig
# Copyright (c) 2026 OE5XRX
# SPDX-License-Identifier: LGPL-3.0-or-later
menu "Audio drivers"
rsource "analog_audio_in/Kconfig"
rsource "analog_audio_out/Kconfig"
endmenu
```

## drivers/audio/analog_audio_in/Kconfig
```kconfig
# Copyright (c) 2026 OE5XRX
# SPDX-License-Identifier: LGPL-3.0-or-later

config ANALOG_AUDIO_IN
	bool "Hardware-timed analog audio capture (TIM+ADC+DMA)"
	default y
	depends on DT_HAS_OE5XRX_ANALOG_AUDIO_IN_ENABLED
	select DMA
	select ADC
	help
	  Timer-TRGO-triggered ADC + circular DMA analog audio capture driver.
	  Requires the Zephyr ADC driver: this driver runs the timed capture via
	  LL + DMA but relies on the adc_stm32 binding for the ADC pinctrl (analog
	  mode) and peripheral bring-up it layers on top of.

if ANALOG_AUDIO_IN

config ANALOG_AUDIO_IN_INIT_PRIORITY
	int "Init priority"
	default 90
	help
	  Device init priority. Must be after the DMA and ADC drivers.

module = ANALOG_AUDIO_IN
module-str = analog_audio_in
source "subsys/logging/Kconfig.template.log_config"
endif
```

## drivers/audio/analog_audio_out/Kconfig
```kconfig
# Copyright (c) 2026 OE5XRX
# SPDX-License-Identifier: LGPL-3.0-or-later

config ANALOG_AUDIO_OUT
	bool "Hardware-timed analog audio playback (TIM+DAC+DMA)"
	default y
	depends on DT_HAS_OE5XRX_ANALOG_AUDIO_OUT_ENABLED
	select DMA
	select DAC
	help
	  Timer-TRGO-triggered DAC + circular DMA analog audio playback driver.
	  Requires the Zephyr DAC driver: this driver runs the timed playback via
	  LL + DMA but relies on the dac_stm32 binding for the DAC pinctrl (analog
	  mode) and peripheral bring-up it layers on top of.

if ANALOG_AUDIO_OUT
config ANALOG_AUDIO_OUT_INIT_PRIORITY
	int "Init priority"
	default 90
	help
	  Device init priority. Must be after the DMA and DAC drivers.

module = ANALOG_AUDIO_OUT
module-str = analog_audio_out
source "subsys/logging/Kconfig.template.log_config"
endif
```

## drivers/dac/Kconfig
```kconfig
# SPDX-License-Identifier: LGPL-3.0-or-later
# Copyright (c) 2025 OE5XRX

menuconfig DAC_WAV
	bool "WAV File DAC Emulator"
	depends on DAC
	help
	  Enable WAV file DAC emulator driver. This driver implements
	  the Zephyr DAC API but writes audio samples to a WAV file
	  instead of sending them to hardware. Useful for testing and
	  simulation on native_sim platform.

if DAC_WAV

config DAC_WAV_INIT_PRIORITY
	int "WAV DAC init priority"
	default 40
	help
	  WAV DAC initialization priority. Must be lower than devices that use it
	  (typically CONFIG_KERNEL_INIT_PRIORITY_DEVICE=50).

config DAC_WAV_SAMPLE_RATE
	int "Default sample rate (Hz)"
	default 8000
	help
	  Default sample rate for WAV file output in Hz.

choice DAC_WAV_BITS_PER_SAMPLE_CHOICE
	prompt "Bits per sample"
	default DAC_WAV_BITS_PER_SAMPLE_16
	help
	  Select the number of bits per audio sample in WAV file output.

config DAC_WAV_BITS_PER_SAMPLE_8
	bool "8 (unsigned)"

config DAC_WAV_BITS_PER_SAMPLE_16
	bool "16 (signed)"

endchoice

config DAC_WAV_BITS_PER_SAMPLE
	int
	default 8 if DAC_WAV_BITS_PER_SAMPLE_8
	default 16 if DAC_WAV_BITS_PER_SAMPLE_16
	help
	  Number of bits per audio sample in WAV file output.
	  This value is derived from the selected bits-per-sample option.

config DAC_WAV_BUFFER_SIZE
	int "Internal buffer size (samples)"
	default 1024
	help
	  Number of samples to buffer before writing to file.

endif # DAC_WAV
```

## drivers/radio/sa818/Kconfig
```kconfig
# Copyright (c) 2025 OE5XRX
# SPDX-License-Identifier: LGPL-3.0-or-later

# SA818 Radio Driver Kconfig
# Configuration options for SA818/SA818S FM transceiver driver

config SA818
  bool "SA818 FM transceiver driver"
  default n
  depends on SERIAL
  depends on GPIO
  select UART_INTERRUPT_DRIVEN
  help
    Driver for SA818 / SA818S UART-controlled FM transceiver modules.
    The AT-command RX path is interrupt-driven; UART_INTERRUPT_DRIVEN
    is required (selected automatically) since the ISR-fed ring_buf
    read path has no polling fallback.

if SA818

config SA818_SHELL
  bool "SA818 shell commands"
  default n
  depends on SHELL
  help
    Enable shell commands for SA818 driver (status, power, ptt, frequency, etc.)

endif # SA818
```

## dts/bindings/audio/oe5xrx,analog-audio-in.yaml
```yaml
# Copyright (c) 2026 OE5XRX
# SPDX-License-Identifier: LGPL-3.0-or-later

description: |
  Hardware-timed analog audio capture: a timer TRGO drives periodic ADC
  conversions into a circular DMA buffer. STM32-specific.

compatible: "oe5xrx,analog-audio-in"

include: base.yaml

properties:
  io-channels:
    type: phandle-array
    required: true
    description: ADC instance + channel used for the audio input.
  io-channel-names:
    type: string-array
    required: false
    description: Optional names for io-channels (e.g. "audio_in").
  sampling-timer:
    type: phandle
    required: true
    description: Timer node whose TRGO paces conversions (master-mode = UPDATE).
  dmas:
    type: phandle-array
    required: true
    description: RX DMA channel that moves ADC conversions into the circular buffer.
  dma-names:
    type: string-array
    required: true
    description: Name for the RX DMA channel (must include "rx").
  sampling-frequency:
    type: int
    required: true
    description: Sample rate in Hz (e.g. 8000).
  resolution:
    type: int
    required: true
    description: ADC resolution in bits (e.g. 12).
  block-samples:
    type: int
    required: true
    description: Samples per DMA half-buffer / per consumer callback.
```

## dts/bindings/audio/oe5xrx,analog-audio-out.yaml
```yaml
# Copyright (c) 2026 OE5XRX
# SPDX-License-Identifier: LGPL-3.0-or-later

description: |
  Hardware-timed analog audio playback: a timer TRGO paces DAC conversions fed
  from a circular memory->DAC DMA. STM32-specific.

compatible: "oe5xrx,analog-audio-out"

include: base.yaml

properties:
  io-channels:
    type: phandle-array
    required: true
    description: DAC instance + channel used for the audio output.
  io-channel-names:
    type: string-array
    required: false
    description: Optional names for io-channels (e.g. "audio_out").
  sampling-timer:
    type: phandle
    required: true
  dmas:
    type: phandle-array
    required: true
    description: TX DMA channel that moves DAC codes from the circular buffer.
  dma-names:
    type: string-array
    required: true
    description: Name for the TX DMA channel (must include "tx").
  sampling-frequency:
    type: int
    required: true
  resolution:
    type: int
    required: true
  block-samples:
    type: int
    required: true
```

## dts/bindings/dac/wav-dac.yaml
```yaml
# SPDX-License-Identifier: LGPL-3.0-or-later
# Copyright (c) 2025 OE5XRX

description: |
  WAV File DAC Emulator
  
  This driver emulates a DAC by writing audio samples to a WAV file.
  Useful for testing and simulation on platforms without real hardware DAC.
  
  The sample rate and bits-per-sample are configured via Kconfig:
  - CONFIG_DAC_WAV_SAMPLE_RATE (default: 8000 Hz)
  - CONFIG_DAC_WAV_BITS_PER_SAMPLE (default: 16-bit)
  
  Example devicetree node:
  
    wav_dac: dac@0 {
        compatible = "wav-dac";
        #io-channel-cells = <1>;
        output-file = "audio_output.wav";
        channels = <1>;
    };

compatible: "wav-dac"

include: [dac-controller.yaml]

io-channel-cells:
  - channel

properties:
  output-file:
    type: string
    required: true
    description: Path to output WAV file

  channels:
    type: int
    default: 1
    enum:
      - 1
      - 2
    description: Number of audio channels (1=mono, 2=stereo)

  resolution:
    type: int
    default: 16
    description: DAC resolution in bits
```

## dts/bindings/radio/sa,sa818.yaml
```yaml
# Copyright (c) 2025 OE5XRX
# SPDX-License-Identifier: LGPL-3.0-or-later

# SA818/SA818S FM Transceiver Module Device Tree Binding
# Defines properties for NiceRF SA818 UART-controlled VHF/UHF radio module

description: SA818 / SA818S FM transceiver module

compatible: "sa,sa818"

include: base.yaml

properties:
  band:
    type: string
    required: true
    enum:
      - "vhf"
      - "uhf"
    description: >
      RF band of the fitted SA818 part. SA818-V = vhf (134-174 MHz),
      SA818-U = uhf (400-480 MHz).

  uart:
    type: phandle
    required: true
    description: UART interface used for SA818 control commands

  h-l-power-gpios:
    type: phandle-array
    required: true
    description: High/Low power select GPIO

  nptt-gpios:
    type: phandle-array
    required: true
    description: Active-low PTT control GPIO

  npower-down-gpios:
    type: phandle-array
    required: true
    description: Active-low power-down GPIO

  nsquelch-gpios:
    type: phandle-array
    required: true
    description: Active-low squelch indicator GPIO

  tx-enable-delay-ms:
    type: int
    default: 20
    description: Delay after enabling TX before audio is considered valid

  rx-settle-time-ms:
    type: int
    default: 50
    description: Delay after RX activation before audio is considered stable
```

## subsys/module/Kconfig
```kconfig
# Copyright (c) 2025 OE5XRX
# SPDX-License-Identifier: LGPL-3.0-or-later

menuconfig MODULE
  bool "OE5XRX module platform (self-describing device capability interface)"
  help
    Generic, machine-readable module capability framework (the `module` shell
    interface). Concrete device modules are enabled below.

if MODULE

config MODULE_SA818
  bool "SA818 FM transceiver module"
  default n
  depends on SHELL
  select SA818
  select CBPRINTF_FP_SUPPORT
  help
    Registers the generic `module` shell interface for the SA818 FM transceiver,
    mapping the capability contract onto the SA818 driver.

endif # MODULE
```

## tests/boot_confirm/testcase.yaml
```yaml
tests:
  boot_confirm.health_gate:
    platform_allow:
      - native_sim/native/64
    tags: boot_confirm mcuboot
    harness: ztest
```

## tests/etl/testcase.yaml
```yaml
# Copyright (c) 2025 OE5XRX
# SPDX-License-Identifier: LGPL-3.0-or-later

tests:
  fm.etl.smoke:
    platform_allow:
      - native_sim/native/64
    tags: etl
    harness: ztest
```

## tests/sim_shell/testcase.yaml
```yaml
# Copyright (c) 2025 OE5XRX
# SPDX-License-Identifier: LGPL-3.0-or-later

# Simulation Shell Test Configuration
# Pytest-based integration tests for SA818 and audio subsystems

tests:
  fm.sim_shell:
    platform_allow:
      - native_sim/native/64
#      - fm_board
    harness: pytest
    # All pytest files run back-to-back in one native_sim instance, so this is
    # the *aggregate* budget for the whole suite (real wall-clock, incl. WAV
    # file IO). Measured ~81 s locally; keep generous headroom as the suite grows.
    timeout: 240
    harness_config:
      pytest_root:
        - pytest
```

## tests/unit_audio/testcase.yaml
```yaml
# Copyright (c) 2025 OE5XRX
# SPDX-License-Identifier: LGPL-3.0-or-later

tests:
  fm.unit_audio.feedback:
    platform_allow:
      - native_sim/native/64
    tags: audio
    harness: ztest
```

## tests/usb_audio/testcase.yaml
```yaml
# Copyright (c) 2025 OE5XRX
# SPDX-License-Identifier: LGPL-3.0-or-later

# USB Audio Bridge Tests
# Tests for application-level USB Audio Class 2 integration

tests:
  fm.usb_audio.build:
    # Build test - verifies USB Audio compiles for fm_board
    build_only: true
    platform_allow:
      - fm_board/stm32f302xc
    tags:
      - usb
      - audio
    
  fm.usb_audio.stream:
    # Runtime test on fm_board with USB Audio enabled
    platform_allow:
      - fm_board/stm32f302xc
    harness: pytest
    harness_config:
      pytest_root:
        - pytest
    tags:
      - usb
      - audio
      - hardware
    integration_platforms:
      - fm_board/stm32f302xc
```
