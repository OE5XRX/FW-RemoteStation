/*
 * Copyright (c) 2025 OE5XRX
 * SPDX-License-Identifier: LGPL-3.0-or-later
 *
 * FM Board Device Tree
 * Hardware configuration for STM32U575CITx-based FM transceiver board
 * with SA818 radio module and USB composite device (CDC, UAC2; DFU configured via Kconfig)
 */

/dts-v1/;
#include "fm_board-common.dtsi"

/ {
	model = "FM-Transceiver for the OE5XRX Remote Station";
	compatible = "oe5xrx,fm_board";

	#address-cells = <1>;
	#size-cells = <1>;

	chosen {
		zephyr,console = &cdc_acm_uart0;
		zephyr,shell-uart = &cdc_acm_uart0;
		zephyr,sram = &sram0;
		zephyr,flash = &flash0;
		zephyr,code-partition = &slot0_partition;
	};

	aliases {
		sa818 = &sa818;
		watchdog0 = &iwdg;
	};
};
